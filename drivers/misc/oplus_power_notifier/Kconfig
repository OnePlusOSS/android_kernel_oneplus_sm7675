## drivers/misc/oplus_power_notifier/Kconfig
```kconfig
#
# oplus power notifier driver configuration
#

config OPLUS_POWER_NOTIFIER
	tristate "oplus power notifier"
	default m
	help
	  Say Y here if you use oplus power notifier.
	  If unsure, say N.
```

## drivers/regulator/camera_aw37004/Kconfig
```kconfig
config OPLUS_CAMERA_AW37004
	tristate "config oplus camera_aw37004 software"
	help
	  Say Y here to support the AW37004 PMIC chip.
	  This driver controls AW37004 PMIC chip and the voltage
	  regulators found in Qualcomm Technologies Inc. AW37004
	  PMIC.
```
